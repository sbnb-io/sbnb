## Config.in
```kconfig
source "$BR2_EXTERNAL_REEFY_PATH/package/sevctl/Config.in"
source "$BR2_EXTERNAL_REEFY_PATH/package/snpguest/Config.in"
source "$BR2_EXTERNAL_REEFY_PATH/package/fatresize/Config.in"
source "$BR2_EXTERNAL_REEFY_PATH/package/python-ansible-core/Config.in"
source "$BR2_EXTERNAL_REEFY_PATH/package/python-resolvelib/Config.in"
source "$BR2_EXTERNAL_REEFY_PATH/package/python-varlink/Config.in"
source "$BR2_EXTERNAL_REEFY_PATH/package/reefy-ansible-collections/Config.in"
source "$BR2_EXTERNAL_REEFY_PATH/package/mgmt/Config.in"
source "$BR2_EXTERNAL_REEFY_PATH/package/nvidia-open-gpu/Config.in"
source "$BR2_EXTERNAL_REEFY_PATH/package/nvidia-gsp-firmware/Config.in"
source "$BR2_EXTERNAL_REEFY_PATH/package/nvidia-userspace/Config.in"
source "$BR2_EXTERNAL_REEFY_PATH/package/nvidia-container-toolkit/Config.in"
source "$BR2_EXTERNAL_REEFY_PATH/package/intel-npu-firmware/Config.in"
source "$BR2_EXTERNAL_REEFY_PATH/package/borgbackup/Config.in"
source "$BR2_EXTERNAL_REEFY_PATH/package/r8125/Config.in"
source "$BR2_EXTERNAL_REEFY_PATH/package/r8126/Config.in"
source "$BR2_EXTERNAL_REEFY_PATH/package/r8127/Config.in"
source "$BR2_EXTERNAL_REEFY_PATH/package/r8168/Config.in"
source "$BR2_EXTERNAL_REEFY_PATH/package/tailscale-reefy/Config.in"
source "$BR2_EXTERNAL_REEFY_PATH/package/thin-provisioning-tools/Config.in"
```

## configs/reefy_defconfig
```kconfig
BR2_x86_64=y
BR2_TOOLCHAIN_BUILDROOT_CXX=y
BR2_CCACHE=y
BR2_INIT_SYSTEMD=y
BR2_PACKAGE_SYSTEMD_ANALYZE=y
BR2_SYSTEM_DEFAULT_PATH="/bin:/sbin:/usr/bin:/usr/sbin"
BR2_GENERATE_LOCALE="en_US"
BR2_TARGET_GENERIC_ISSUE="Welcome to Reefy"
BR2_ROOTFS_OVERLAY="$(BR2_EXTERNAL_REEFY_PATH)/board/reefy/reefy/rootfs-overlay"
BR2_ROOTFS_PRE_BUILD_SCRIPT="$(BR2_EXTERNAL_REEFY_PATH)/board/reefy/reefy/pre_build.sh"
BR2_ROOTFS_POST_BUILD_SCRIPT="$(BR2_EXTERNAL_REEFY_PATH)/board/reefy/reefy/post_build.sh"
BR2_ROOTFS_POST_IMAGE_SCRIPT="$(BR2_EXTERNAL_REEFY_PATH)/board/reefy/reefy/post_image.sh"
BR2_LINUX_KERNEL_GZIP=y
BR2_LINUX_KERNEL=y
BR2_LINUX_KERNEL_USE_CUSTOM_CONFIG=y
# Switch back to upstream kernel once Restricted Injection hypervisor support
# patches merged: https://lore.kernel.org/lkml/Z08J0EVu0VeA7Z%2FR@rli9-mobl/T/
BR2_LINUX_KERNEL_CUSTOM_GIT=y
BR2_LINUX_KERNEL_CUSTOM_REPO_URL="https://git.kernel.org/pub/scm/linux/kernel/git/stable/linux.git"
BR2_LINUX_KERNEL_CUSTOM_REPO_VERSION="v6.18.40"
BR2_LINUX_KERNEL_CUSTOM_CONFIG_FILE="$(BR2_EXTERNAL_REEFY_PATH)/board/reefy/reefy/kernel-config"
BR2_LINUX_KERNEL_CONFIG_FRAGMENT_FILES="$(BR2_EXTERNAL_REEFY_PATH)/board/reefy/reefy/kernel-config-wifi"
BR2_LINUX_KERNEL_NEEDS_HOST_LIBELF=y
BR2_PACKAGE_LINUX_FIRMWARE=y
BR2_PACKAGE_LINUX_FIRMWARE_XE=y
BR2_PACKAGE_LINUX_FIRMWARE_RTL_81XX=y
BR2_PACKAGE_LINUX_FIRMWARE_RTL_87XX=y
BR2_PACKAGE_LINUX_FIRMWARE_RTL_88XX=y
BR2_PACKAGE_LINUX_FIRMWARE_RTL_RTW88=y
BR2_PACKAGE_LINUX_FIRMWARE_RTL_RTW89=y
BR2_PACKAGE_LINUX_FIRMWARE_RTL_8169=y
BR2_PACKAGE_LINUX_FIRMWARE_MEDIATEK_MT7922=y
BR2_PACKAGE_HOST_LINUX_HEADERS_CUSTOM_6_18=y
BR2_PACKAGE_LINUX_TOOLS_CPUPOWER=y
BR2_PACKAGE_XZ=y
BR2_PACKAGE_STRACE=y
BR2_PACKAGE_E2FSPROGS=y
BR2_PACKAGE_E2FSPROGS_DEBUGFS=y
BR2_PACKAGE_E2FSPROGS_E2IMAGE=y
BR2_PACKAGE_E2FSPROGS_E4DEFRAG=y
BR2_PACKAGE_E2FSPROGS_FUSE2FS=y
BR2_PACKAGE_E2FSPROGS_RESIZE2FS=y
BR2_PACKAGE_XFSPROGS=y
BR2_PACKAGE_XORG7=y
BR2_PACKAGE_XLIB_LIBX11=y
BR2_PACKAGE_DMIDECODE=y
BR2_PACKAGE_SMARTMONTOOLS=y
BR2_PACKAGE_HWDATA=y
BR2_PACKAGE_HWDATA_IAB_OUI_TXT=y
BR2_PACKAGE_HWDATA_PNP_IDS=y
# BR2_PACKAGE_HWDATA_USB_IDS is not set
BR2_PACKAGE_INTEL_MICROCODE=y
BR2_PACKAGE_IPMITOOL=y
BR2_PACKAGE_IPMITOOL_LANPLUS=y
BR2_PACKAGE_NVME=y
BR2_PACKAGE_PARTED=y
BR2_PACKAGE_PROCPS_NG=y
BR2_PACKAGE_SYSSTAT=y
BR2_PACKAGE_CA_CERTIFICATES=y
BR2_PACKAGE_LIBOPENSSL_BIN=y
BR2_PACKAGE_LIBCURL=y
BR2_PACKAGE_LIBCURL_CURL=y
BR2_PACKAGE_SLANG=y
BR2_PACKAGE_BIRD=y
BR2_PACKAGE_NETCAT_OPENBSD=y
BR2_PACKAGE_OPENSSH=y
BR2_PACKAGE_RSYNC=y
BR2_PACKAGE_WIREGUARD_TOOLS=y
BR2_PACKAGE_BASH=y
BR2_PACKAGE_SUDO=y
BR2_PACKAGE_TMUX=y
BR2_PACKAGE_DOCKER_CLI_BUILDX=y
BR2_PACKAGE_DOCKER_COMPOSE=y
BR2_PACKAGE_DOCKER_ENGINE=y
BR2_PACKAGE_DOCKER_ENGINE_DRIVER_BTRFS=y
BR2_PACKAGE_DOCKER_ENGINE_DRIVER_DEVICEMAPPER=y
BR2_PACKAGE_DOCKER_ENGINE_DRIVER_VFS=y
BR2_PACKAGE_EFIBOOTMGR=y
BR2_PACKAGE_UTIL_LINUX_WIPEFS=y
BR2_TARGET_SYSLINUX=y
BR2_TARGET_SYSLINUX_MBR=y
BR2_TARGET_SYSLINUX_EFI=y
BR2_PACKAGE_HOST_KMOD_XZ=y
BR2_PACKAGE_HOST_PYTHON3=y
BR2_PACKAGE_HOST_PYTHON3_BZIP2=y
BR2_PACKAGE_HOST_PYTHON3_XZ=y
BR2_PACKAGE_HOST_PYTHON3_CURSES=y
BR2_PACKAGE_HOST_PYTHON3_SSL=y
BR2_PACKAGE_AVAHI=y
BR2_PACKAGE_AVAHI_DAEMON=y
BR2_PACKAGE_TAILSCALE_REEFY=y
BR2_TARGET_ROOTFS_CPIO=y
BR2_TARGET_ROOTFS_CPIO_XZ=y
BR2_PACKAGE_SEVCTL=y
BR2_PACKAGE_SNPGUEST=y
BR2_PACKAGE_TPM2_TOOLS=y
BR2_PACKAGE_BUSYBOX_CONFIG_FRAGMENT_FILES="$(BR2_EXTERNAL_REEFY_PATH)/board/reefy/reefy/busybox.fragment"
BR2_TARGET_ROOTFS_SQUASHFS=y
BR2_TARGET_ROOTFS_SQUASHFS4_XZ=y
BR2_PACKAGE_OPENVMTOOLS=y
BR2_SHARED_STATIC_LIBS=y
BR2_PACKAGE_FATRESIZE=y
BR2_PACKAGE_MOKUTIL=y
BR2_PACKAGE_IPERF3=y
BR2_PACKAGE_TCPDUMP=y
BR2_PACKAGE_CRYPTSETUP=y
BR2_PACKAGE_DOSFSTOOLS=y
BR2_PACKAGE_DOSFSTOOLS_FATLABEL=y
BR2_PACKAGE_DOSFSTOOLS_FSCK_FAT=y
BR2_PACKAGE_DOSFSTOOLS_MKFS_FAT=y
BR2_PACKAGE_PYTHON3=y
BR2_PACKAGE_PYTHON3_PY_PYC=y
BR2_PACKAGE_PYTHON_PIP=y
BR2_PACKAGE_PYTHON3_ZLIB=y
BR2_PACKAGE_PYTHON_REQUESTS=y
BR2_PACKAGE_PYTHON_DOCKER=y
BR2_PACKAGE_PYTHON_ANSIBLE_CORE=y
BR2_PACKAGE_PYTHON_RESOLVELIB=y
BR2_PACKAGE_PYTHON_VARLINK=y
BR2_PACKAGE_PYTHON_PAHO_MQTT=y
BR2_PACKAGE_PYTHON_PSUTIL=y
BR2_PACKAGE_REEFY_ANSIBLE_COLLECTIONS=y
BR2_PACKAGE_MGMT=y
BR2_PACKAGE_F2FS_TOOLS=y
BR2_PACKAGE_FIO=y
BR2_PACKAGE_USBUTILS=y
BR2_PACKAGE_NVIDIA_OPEN_GPU=y
BR2_PACKAGE_NVIDIA_CONTAINER_TOOLKIT=y
BR2_PACKAGE_INTEL_NPU_FIRMWARE=y
BR2_PACKAGE_BORGBACKUP=y
BR2_PACKAGE_R8125=y
BR2_PACKAGE_R8126=y
BR2_PACKAGE_R8127=y
BR2_PACKAGE_R8168=y
BR2_PACKAGE_JQ=y
BR2_PACKAGE_LOGROTATE=y
# ttyd binary stays in the image as a manual fallback for terminal
# access if the MQTT bridge ever breaks. No systemd unit - operator
# starts it ad-hoc via `ttyd -W -i 127.0.0.1 -p 7681 ...`.
BR2_PACKAGE_TTYD=y
BR2_PACKAGE_BRIDGE_UTILS=y
BR2_PACKAGE_ETHTOOL=y
BR2_PACKAGE_IPROUTE2=y
BR2_PACKAGE_IW=y
BR2_PACKAGE_WIRELESS_TOOLS=y
BR2_PACKAGE_WPA_SUPPLICANT=y
BR2_PACKAGE_WPA_SUPPLICANT_NL80211=y
BR2_PACKAGE_WPA_SUPPLICANT_CLI=y
BR2_PACKAGE_WPA_SUPPLICANT_PASSPHRASE=y
```

## package/intel-npu-firmware/Config.in
```kconfig
config BR2_PACKAGE_INTEL_NPU_FIRMWARE
	bool "intel-npu-firmware"
	depends on BR2_x86_64
	help
	  Intel NPU firmware for Meteor Lake, Lunar Lake, and newer Intel
	  Core Ultra systems using the in-kernel intel_vpu driver.

	  Firmware files are installed from the official upstream
	  linux-firmware release at kernel.org. This package installs only
	  intel/vpu firmware so we can use a newer NPU firmware set without
	  globally bumping every firmware blob in the image.

	  https://git.kernel.org/pub/scm/linux/kernel/git/firmware/linux-firmware.git
```

## package/nvidia-container-toolkit/Config.in
```kconfig
config BR2_PACKAGE_NVIDIA_CONTAINER_TOOLKIT
	bool "nvidia-container-toolkit"
	depends on BR2_x86_64
	depends on BR2_PACKAGE_HOST_GO_TARGET_CGO_LINKING_SUPPORTS
	help
	  Build NVIDIA Container Toolkit binaries for the Reefy NVIDIA
	  provider artifact. The binaries are staged outside TARGET_DIR and
	  are not embedded in the Reefy OS image.

	  https://github.com/NVIDIA/nvidia-container-toolkit
```

## package/python-varlink/Config.in
```kconfig
config BR2_PACKAGE_PYTHON_VARLINK
	bool "python-varlink"
	help
	  Pure-Python implementation of the Varlink protocol (client +
	  server, unix-socket transport). Used by the reefy control plane
	  and reconciler for local request/response IPC.

	  https://github.com/varlink/python
```

## package/thin-provisioning-tools/Config.in
```kconfig
config BR2_PACKAGE_THIN_PROVISIONING_TOOLS
	bool "thin-provisioning-tools"
	depends on BR2_PACKAGE_HOST_RUSTC_TARGET_ARCH_SUPPORTS
	select BR2_PACKAGE_HOST_RUSTC
	select BR2_PACKAGE_LVM2
	help
	  Tools for checking, dumping, and repairing device-mapper thin
	  provisioning metadata.

	  https://github.com/device-mapper-utils/thin-provisioning-tools
```
