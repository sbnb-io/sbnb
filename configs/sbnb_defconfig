## configs/sbnb_defconfig
```kconfig
BR2_x86_64=y
BR2_CCACHE=y
BR2_INIT_SYSTEMD=y
BR2_SYSTEM_DEFAULT_PATH="/bin:/sbin:/usr/bin:/usr/sbin"
BR2_GENERATE_LOCALE="en_US"
BR2_ROOTFS_OVERLAY="$(BR2_EXTERNAL_SBNB_PATH)/board/sbnb/sbnb/rootfs-overlay"
BR2_ROOTFS_PRE_BUILD_SCRIPT="$(BR2_EXTERNAL_SBNB_PATH)/board/sbnb/sbnb/pre_build.sh"
BR2_ROOTFS_POST_BUILD_SCRIPT="$(BR2_EXTERNAL_SBNB_PATH)/board/sbnb/sbnb/post_build.sh"
BR2_ROOTFS_POST_IMAGE_SCRIPT="$(BR2_EXTERNAL_SBNB_PATH)/board/sbnb/sbnb/post_image.sh"
BR2_LINUX_KERNEL_GZIP=y
BR2_LINUX_KERNEL=y
BR2_LINUX_KERNEL_USE_CUSTOM_CONFIG=y
# Switch back to upstream kernel once Restricted Injection hypervisor support
# patches merged: https://lore.kernel.org/lkml/Z08J0EVu0VeA7Z%2FR@rli9-mobl/T/
BR2_LINUX_KERNEL_CUSTOM_GIT=y
BR2_LINUX_KERNEL_CUSTOM_REPO_URL="https://git.kernel.org/pub/scm/linux/kernel/git/stable/linux.git"
BR2_LINUX_KERNEL_CUSTOM_REPO_VERSION="linux-6.14.y"
BR2_LINUX_KERNEL_CUSTOM_CONFIG_FILE="$(BR2_EXTERNAL_SBNB_PATH)/board/sbnb/sbnb/kernel-config"
BR2_LINUX_KERNEL_CONFIG_FRAGMENT_FILES="kernel-config-firmware"
BR2_LINUX_KERNEL_NEEDS_HOST_LIBELF=y
BR2_PACKAGE_HOST_LINUX_HEADERS_CUSTOM_6_14=y
BR2_PACKAGE_LINUX_TOOLS_CPUPOWER=y
BR2_PACKAGE_XZ=y
BR2_PACKAGE_STRACE=y
BR2_PACKAGE_E2FSPROGS=y
BR2_PACKAGE_E2FSPROGS_DEBUGFS=y
BR2_PACKAGE_E2FSPROGS_E2IMAGE=y
BR2_PACKAGE_E2FSPROGS_E4DEFRAG=y
BR2_PACKAGE_E2FSPROGS_FUSE2FS=y
BR2_PACKAGE_E2FSPROGS_RESIZE2FS=y
BR2_PACKAGE_XORG7=y
BR2_PACKAGE_XLIB_LIBX11=y
BR2_PACKAGE_DMIDECODE=y
BR2_PACKAGE_HWDATA=y
BR2_PACKAGE_HWDATA_IAB_OUI_TXT=y
BR2_PACKAGE_HWDATA_PNP_IDS=y
# BR2_PACKAGE_HWDATA_USB_IDS is not set
BR2_PACKAGE_INTEL_MICROCODE=y
BR2_PACKAGE_IPMITOOL=y
BR2_PACKAGE_IPMITOOL_LANPLUS=y
BR2_PACKAGE_NVME=y
BR2_PACKAGE_PARTED=y
BR2_PACKAGE_SYSSTAT=y
BR2_PACKAGE_CA_CERTIFICATES=y
BR2_PACKAGE_LIBOPENSSL_BIN=y
BR2_PACKAGE_LIBCURL=y
BR2_PACKAGE_LIBCURL_CURL=y
BR2_PACKAGE_SLANG=y
BR2_PACKAGE_BIRD=y
BR2_PACKAGE_NETCAT_OPENBSD=y
BR2_PACKAGE_OPENSSH=y
BR2_PACKAGE_WIREGUARD_TOOLS=y
BR2_PACKAGE_SUDO=y
BR2_PACKAGE_TMUX=y
BR2_PACKAGE_DOCKER_CLI_BUILDX=y
BR2_PACKAGE_DOCKER_COMPOSE=y
BR2_PACKAGE_DOCKER_ENGINE=y
BR2_PACKAGE_DOCKER_ENGINE_DRIVER_BTRFS=y
BR2_PACKAGE_DOCKER_ENGINE_DRIVER_DEVICEMAPPER=y
BR2_PACKAGE_DOCKER_ENGINE_DRIVER_VFS=y
BR2_PACKAGE_EFIBOOTMGR=y
BR2_PACKAGE_UTIL_LINUX_WIPEFS=y
BR2_TARGET_SYSLINUX=y
BR2_TARGET_SYSLINUX_MBR=y
BR2_TARGET_SYSLINUX_EFI=y
BR2_PACKAGE_HOST_KMOD_XZ=y
BR2_PACKAGE_HOST_PYTHON3=y
BR2_PACKAGE_HOST_PYTHON3_BZIP2=y
BR2_PACKAGE_HOST_PYTHON3_XZ=y
BR2_PACKAGE_HOST_PYTHON3_CURSES=y
BR2_PACKAGE_HOST_PYTHON3_SSL=y
BR2_PACKAGE_TAILSCALE=y
BR2_TARGET_ROOTFS_CPIO=y
BR2_TARGET_ROOTFS_CPIO_XZ=y
BR2_PACKAGE_SEVCTL=y
BR2_PACKAGE_SNPGUEST=y
BR2_PACKAGE_TPM2_TOOLS=y
BR2_PACKAGE_BUSYBOX_CONFIG_FRAGMENT_FILES="$(BR2_EXTERNAL_SBNB_PATH)/board/sbnb/sbnb/busybox.fragment"
BR2_TARGET_ROOTFS_SQUASHFS=y
BR2_TARGET_ROOTFS_SQUASHFS4_XZ=y
BR2_PACKAGE_OPENVMTOOLS=y
BR2_SHARED_STATIC_LIBS=y
BR2_PACKAGE_FATRESIZE=y
BR2_PACKAGE_MOKUTIL=y
BR2_PACKAGE_TCPDUMP=y
BR2_PACKAGE_DOSFSTOOLS=y
BR2_PACKAGE_DOSFSTOOLS_FATLABEL=y
BR2_PACKAGE_DOSFSTOOLS_FSCK_FAT=y
BR2_PACKAGE_DOSFSTOOLS_MKFS_FAT=y
BR2_PACKAGE_PYTHON3=y
BR2_PACKAGE_PYTHON_PIP=y
BR2_PACKAGE_PYTHON3_ZLIB=y
BR2_PACKAGE_PYTHON_REQUESTS=y
BR2_PACKAGE_JQ=y
```

## package/fatresize/Config.in
```kconfig
config BR2_PACKAGE_FATRESIZE
    bool "fatresize"
    help
      Resize FAT partitions using libparted

      https://github.com/ya-mouse/fatresize
```

## package/python-ansible-core/Config.in
```kconfig
config BR2_PACKAGE_PYTHON_ANSIBLE_CORE
	bool "python-ansible-core"
	select BR2_PACKAGE_PYTHON3
	select BR2_PACKAGE_PYTHON_CRYPTOGRAPHY
	select BR2_PACKAGE_PYTHON_JINJA2
	select BR2_PACKAGE_PYTHON_PACKAGING
	select BR2_PACKAGE_PYTHON_PYYAML
	select BR2_PACKAGE_PYTHON_RESOLVELIB
	help
	  Ansible is a radically simple IT automation platform that
	  makes your applications and systems easier to deploy and
	  maintain. Automate everything from code deployment to
	  network configuration to cloud management.

	  This package installs ansible-core, the foundational
	  component that includes ansible-playbook, ansible-vault,
	  and other core utilities.

	  https://www.ansible.com/
```

## package/python-resolvelib/Config.in
```kconfig
config BR2_PACKAGE_PYTHON_RESOLVELIB
	bool "python-resolvelib"
	help
	  A Python library to resolve abstract dependencies into
	  concrete ones. Used by Ansible for dependency resolution.

	  https://github.com/sarugaku/resolvelib
```

## package/sevctl/Config.in
```kconfig
config BR2_PACKAGE_SEVCTL
	bool "sevctl"
	depends on BR2_PACKAGE_HOST_RUSTC_TARGET_ARCH_SUPPORTS
	select BR2_PACKAGE_HOST_RUSTC
	help
	  Administrative utility for AMD SEV

	  https://github.com/virtee/sevctl.git
```

## package/snpguest/Config.in
```kconfig
config BR2_PACKAGE_SNPGUEST
	bool "snpguest"
	depends on BR2_PACKAGE_HOST_RUSTC_TARGET_ARCH_SUPPORTS
	select BR2_PACKAGE_HOST_RUSTC
	help
	  A CLI tool for interacting with SEV-SNP guest environment

	  https://github.com/virtee/snpguest.git
```
